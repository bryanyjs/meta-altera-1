## conf/machine/cyclone5.conf
```bitbake
#@TYPE: Machine
#@NAME: cyclone5
#@DESCRIPTION: Machine configuration for the Cyclone V SoC" 

require conf/machine/include/socfpga.inc


KMACHINE = "cyclone5"

# Serial Console Setting 
SERIAL_CONSOLES ?= "115200;ttyS0"

IMAGE_BOOT_FILES ?= " \
	${KERNEL_DEVICETREE} \
	${KERNEL_IMAGETYPE} \
	extlinux.conf;extlinux/extlinux.conf \
	"
	
IMAGE_FSTYPES +="tar.gz"
```
